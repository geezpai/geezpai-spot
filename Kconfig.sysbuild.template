## Kconfig.uwb
```kconfig
#
# Copyright (c) 2026 Nordic Semiconductor ASA
# Copyright (c) 2026 Shenzhen Geezpai Technology Co., Ltd.
#
# SPDX-License-Identifier: LicenseRef-Nordic-5-Clause
#

config APP_UWB
        bool "Application UWB host module"
        default y
        select UART_INTERRUPT_DRIVEN
        help
          Enable the application UWB host module that connects to the external
          UWB device through UART and interrupt GPIO.

if APP_UWB

config APP_UWB_RESPONSE_TIMEOUT_MS
        int "UWB response timeout in milliseconds"
        default 200
        range 50 5000
        help
          Timeout used by the UCI host while waiting for responses from the
          UWB module.

config APP_UWB_REASSEMBLE_TIMEOUT_MS
        int "UWB reassemble timeout in milliseconds"
        default 100
        range 20 5000
        help
          Timeout used by the UCI host while waiting for remaining UCI frame
          segments.

config APP_UWB_RX_BUF_ITEMS
        int "UWB receive buffer slots"
        default 4
        range 2 16
        help
          Number of buffered received UCI frames.

config APP_UWB_RX_BUF_LEN
        int "UWB receive buffer length"
        default 259
        range 64 1024
        help
          Maximum bytes stored for a single received UCI frame.

config APP_UWB_PKT_SLOTS
        int "UWB packet slots"
        default 4
        range 2 16
        help
          Number of packet records used by the UCI host per UWB instance.

endif # APP_UWB
```

## configuration/boards/nrf52840dk_nrf52840.conf
```kconfig
#
# Copyright (c) 2026 Nordic Semiconductor ASA
# Copyright (c) 2026 Shenzhen Geezpai Technology Co., Ltd.
#
# SPDX-License-Identifier: LicenseRef-Nordic-5-Clause
#

# Enable code partitioning with DTS
CONFIG_USE_DT_CODE_PARTITION=y
```

## examples/05_findmy/locator_tag/Kconfig
```kconfig
#
# Copyright (c) 2026 Shenzhen Geezpai Technology Co., Ltd.
#
# SPDX-License-Identifier: LicenseRef-Nordic-5-Clause
#
# 指向根目录的 Kconfig，保持与主构建一致。
#

rsource "../../../Kconfig"
```

## examples/05_findmy/locator_tag/Kconfig.sysbuild.template
```kconfig
#
# Copyright (c) 2026 Shenzhen Geezpai Technology Co., Ltd.
#
# SPDX-License-Identifier: LicenseRef-Nordic-5-Clause
#
# ⚠️ 生产构建请从项目根目录执行，使用根目录 Kconfig.sysbuild 中的真实密钥。
#    本文件提供开发/CI 用的默认值。
#

config APP_DFU
	bool "Enable MCUmgr OTA DFU over Bluetooth"
	default y
	depends on BOOTLOADER_MCUBOOT || SOC_SERIES_NRF54H

config BT_FAST_PAIR_MODEL_ID
	hex "Fast Pair Model ID"
	default 0x000000

config BT_FAST_PAIR_ANTI_SPOOFING_PRIVATE_KEY
	string "Fast Pair Anti-Spoofing Private Key"
	default ""

source "share/sysbuild/Kconfig"
```
